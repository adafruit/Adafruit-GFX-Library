//this example comes with video tutorial: https://youtu.be/kV8oMMXbzSM  Here Custom_Button is merged into Adafruit_GFX_Button
//by Gen0me, https://github.com/63n0m3/Custom_Button
//btc: 1A8Gqs2JwdjuAfFZ4cnM4CWy9hGFzsCpzK
#include <MCUFRIEND_kbv.h>      /// Adafruit GFX is included inside this library
MCUFRIEND_kbv tft;
#include <TouchScreen.h>
#include <FreeDefaultFonts.h>
#define MINPRESSURE 200
#define MAXPRESSURE 1000
#define BLACK   0x0000
#define BLUE    0x001F
#define RED     0xF800
#define GREEN   0x07E0
#define CYAN    0x07FF
#define MAGENTA 0xF81F
#define PINK 0b1111101000011011
#define YELLOW  0xFFE0
#define WHITE   0xFFFF

const int XP=8,XM=A2,YP=A3,YM=9; //240x320 ID=0x9595
//const int XP=6,XM=A2,YP=A1,YM=7; //320x480 ID=0x9486
TouchScreen ts = TouchScreen(XP, YP, XM, YM, 300);

int16_t Cursor_X, Cursor_Y;
bool Cursor_Pressed;
bool Touch_getXY(void)
{
    TSPoint p = ts.getPoint();
    pinMode(YP, OUTPUT);      //restore shared pins
    pinMode(XM, OUTPUT);
    digitalWrite(YP, HIGH);   //because TFT control pins
    digitalWrite(XM, HIGH);
    bool pressed = (p.z > MINPRESSURE && p.z < MAXPRESSURE);
    if (pressed) {
        Cursor_X = map(p.y, 94, 905, 0, tft.width());
        Cursor_Y = map(p.x, 129, 918, 0, tft.height());
    //    Cursor_X = map(p.y, 963, 191, 0, tft.width());
    //    Cursor_Y = map(p.x, 185, 929, 0, tft.height());
    }
    return pressed;
}

Adafruit_GFX_Button Ada_But_Exa;
Adafruit_GFX_Button Cus_Mon_Exa;
Adafruit_GFX_Button Cus_Double_16bit_Exa;

const uint8_t Four_mask[] PROGMEM = { 0, 0, 0, 0, 15, 255, 255, 248, 63, 255, 255, 252, 124,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 0, 0};
const uint16_t Return_arr_88x40[] PROGMEM = { 0, 0, 0, 0, 0, 0, 0, 0, 0, 0, 0, 32, 2113,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 0, 0};
const uint16_t ReturnP_arr_88x40[] PROGMEM = { 0, 0, 0, 0, 0, 0, 0, 0, 0, 0, 0, 0, 2048,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 0, 0};
const uint8_t Return_mask[] PROGMEM = { 0, 15, 255, 255, 255, 255, 255, 255, 255, 252, 0, 3, 255,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 0, 0};


void setup() {
//    Serial.begin(9600);
    uint16_t ID = tft.readID();
    tft.begin(ID);
    tft.setRotation(1);
    tft.fillScreen(BLACK);
    tft.setFont(NULL);

    Ada_But_Exa.initButton(&tft,  80, 35, 120, 32, WHITE, GREEN, MAGENTA, "Ada Exa", 2);
    Cus_Mon_Exa.initButton(60, 100, Four_mask, GREEN, PINK, 32, 40, &tft);
    Cus_Double_16bit_Exa.initButton(110, 160, Return_arr_88x40, Return_mask, ReturnP_arr_88x40, Return_mask, 88, 40, &tft);
 //   Cus_Double_16bit_Exa.initButton(110, 160, Return_arr_88x40, NULL, ReturnP_arr_88x40, NULL, 88, 40, &tft);
}

void loop() {
  Ada_But_Exa.drawButton(true);
  Cus_Mon_Exa.drawButton(true);
  Cus_Double_16bit_Exa.drawButton(true);

  while(1){
    Cursor_Pressed = Touch_getXY();

    Ada_But_Exa.press(Cursor_Pressed && Ada_But_Exa.contains(Cursor_X, Cursor_Y));
    if (Ada_But_Exa.justPressed()){
      Ada_But_Exa.drawButton(false);
      Ada_But_Exa.drawButton(true);
    }
    Cus_Mon_Exa.press(Cursor_Pressed && Cus_Mon_Exa.contains(Cursor_X, Cursor_Y));
    if (Cus_Mon_Exa.justPressed()){
      Cus_Mon_Exa.drawButton(false);
      Cus_Mon_Exa.drawButton(true);
    }
    Cus_Double_16bit_Exa.press(Cursor_Pressed && Cus_Double_16bit_Exa.contains(Cursor_X, Cursor_Y));
    if (Cus_Double_16bit_Exa.justPressed()){
      Cus_Double_16bit_Exa.drawButton(false);
      Cus_Double_16bit_Exa.drawButton(true);
    }

/*    if (Cursor_Pressed){
        if (Cus_Double_16bit_Exa.contains (Cursor_X, Cursor_Y) && (Cus_Double_16bit_Exa.Last_Time_Used_millis + 200 < millis())){
          Cus_Double_16bit_Exa.drawButton(false);
          Cus_Double_16bit_Exa.drawButton(true);
        }
        if (Cus_Mon_Exa.contains (Cursor_X, Cursor_Y) && (Cus_Mon_Exa.Last_Time_Used_millis + 200 < millis())){
          Cus_Mon_Exa.drawButton(false);
          Cus_Mon_Exa.drawButton(true);
        }
    }*/

  }
}
